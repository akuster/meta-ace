## conf/layer.conf
```bitbake
# We have a conf and classes directory, add to BBPATH
BBPATH .= ":${LAYERDIR}"

# We have recipes-* directories, add to BBFILES
BBFILES += "${LAYERDIR}/recipes-*/*/*.bb \
	${LAYERDIR}/recipes-*/*/*.bbappend"

BBFILE_COLLECTIONS += "ace"
BBFILE_PATTERN_ace= "^${LAYERDIR}/"
BBFILE_PRIORITY_ace= "6"

# layer depends
LAYERDEPENDS_ace = "core"
LAYERDEPENDS_ace += "openembedded-layer"
```
